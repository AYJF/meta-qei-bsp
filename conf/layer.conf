## conf/layer.conf
```bitbake
# We have a conf and classes directory, add to BBPATH
BBPATH .= ":${LAYERDIR}"

# We have recipes-* directories, add to BBFILES
BBFILES += "${LAYERDIR}/recipes-*/*/*.bb \
            ${LAYERDIR}/recipes-*/*/*.bbappend"

BBFILE_COLLECTIONS += "meta-qei-bsp"
BBFILE_PATTERN_meta-qei-bsp = "^${LAYERDIR}/"
BBFILE_PRIORITY_meta-qei-bsp = "9"

LAYERSERIES_COMPAT_meta-qei-bsp = "kirkstone langdale mickledore"
```
